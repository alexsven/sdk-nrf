## applications/nrf_audio/boards/nrf7120dk_nrf7120_cpuapp.conf
```kconfig
#
# Copyright (c) 2026 Nordic Semiconductor ASA
#
# SPDX-License-Identifier: LicenseRef-Nordic-5-Clause
#

CONFIG_NRFX_I2S=n
CONFIG_AUDIO_SOURCE_USB=y
CONFIG_UDC_DRIVER_HIGH_SPEED_SUPPORT_ENABLED=n

CONFIG_DEVICE_LOCATION_SET_COMPILE_TIME=y
CONFIG_DEVICE_LOCATION_AT_COMPILE_TIME=3
```

## tests/nrf_audio/broadcast_sink/Kconfig
```kconfig
config BROADCAST_SINK_LOG_LEVEL
	int
	default 3

config BLE_LOG_LEVEL
	int
	default 3

config BT_BAP_BASE_LOG_LEVEL
	int
	default 3

config BT_AUDIO_CODEC_LOG_LEVEL
	int
	default 3

config BT_AUDIO_LOG_LEVEL
	int
	default 3

config BT_BUF_EVT_RX_COUNT
	int
	default 10

config BT_BUF_ACL_TX_COUNT
	int
	default 5

config SCAN_MODE_PASSIVE
	bool
	default y

config BT_AUDIO_RX
	bool
	default y

config BT_BAP_BROADCAST_SINK
	bool
	default y

config BT_PAC_SNK
	bool
	default y

config BT_PAC_SNK_LOC
	bool
	default y

config BT_BAP_BROADCAST_SNK_SUBGROUP_COUNT
	int
	default 4

config BT_BAP_BROADCAST_SNK_STREAM_COUNT
	int
	default 2

config BT_AUDIO_CONCURRENT_RX_STREAMS_MAX
	int
	default 2

config BT_AUDIO_CODEC_CFG_MAX_DATA_SIZE
	int
	default 128

config BT_AUDIO_CODEC_CFG_MAX_METADATA_SIZE
	int
	default 128

config BT_AUDIO_CODEC_CAP_MAX_DATA_SIZE
	int
	default 128

config BT_AUDIO_CODEC_CAP_MAX_METADATA_SIZE
	int
	default 128

config BT_ISO_MAX_BIG
	int
	default 1

config BT_ISO_MAX_CHAN
	int
	default 2

config BT_ISO_TX_MTU
	int
	default 120

config LC3_BITRATE_MIN
	int
	default 32000

config LC3_BITRATE_MAX
	int
	default 124000

config AUDIO_SAMPLE_RATE_48000_HZ
	bool
	default y

config AUDIO_FRAME_DURATION_US
	int
	default 10000

config BT_AUDIO_BROADCAST_ENCRYPTION_KEY
	string
	default ""

config BT_SET_IDENTITY_RESOLVING_KEY_DEFAULT
	string
	default ""

config BT_SET_IDENTITY_RESOLVING_KEY
	string
	default ""

config BT_DEVICE_APPEARANCE
	int
	default 0

source "Kconfig"
```

## tests/nrf_audio/broadcast_sink/testcase.yaml
```yaml
tests:
  nrf5340_audio.broadcast_sink_subgroups:
    platform_allow: native_sim/native/64
    integration_platforms:
      - native_sim/native/64
    tags:
      - nrf5340_audio_unit_tests
      - ci_tests_nrf_audio
```

## tests/nrf_audio/multichannel_auracast/testcase.yaml
```yaml
tests:
  nrf_audio.multichannel_auracast:
    platform_allow: native_sim/native/64
    integration_platforms:
      - native_sim/native/64
    tags:
      - nrf5340_audio_unit_tests
      - ci_tests_nrf_audio
```

## tests/nrf_audio/wifi_input/testcase.yaml
```yaml
tests:
  nrf_audio.wifi_input:
    platform_allow: native_sim/native/64
    integration_platforms:
      - native_sim/native/64
    tags:
      - nrf_audio
```
