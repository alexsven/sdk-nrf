## applications/nrf5340_audio/microphone_receiver/Kconfig.defaults
```kconfig
#
# Copyright (c) 2023 Nordic Semiconductor ASA
#
# SPDX-License-Identifier: LicenseRef-Nordic-5-Clause
#

config UTF8
	default y

## ACL related configs ##
config BT_MAX_CONN
	default 5

# Generic Audio Source - 0x0840
config BT_DEVICE_APPEARANCE
	default 2112

config BT_MAX_PAIRED
	default 5

config BT_GATT_DYNAMIC_DB
	default y

## ISO related configs ##
config BT_ISO_MAX_CHAN
	default 5

config BT_BAP_UNICAST_CLIENT
	default y

config BT_ISO_TX_BUF_COUNT
	default 2

config BT_BAP_UNICAST_CLIENT_GROUP_STREAM_COUNT
	default 5

config BT_BAP_UNICAST_CLIENT_ASE_SNK_COUNT
	default 0

config BT_BAP_UNICAST_CLIENT_ASE_SRC_COUNT
	default 5

## LC3 related configs ##
config LC3_BITRATE
	default BT_AUDIO_BITRATE_UNICAST_SINK

config LC3_ENC_CHAN_MAX
	default 0

config LC3_DEC_CHAN_MAX
	default 5
```

## boards/shields/pca63579/Kconfig.shield
```kconfig
# Copyright (c) 2026 Nordic Semiconductor ASA
# SPDX-License-Identifier: LicenseRef-Nordic-5-Clause

config SHIELD_PCA63579
	def_bool $(shields_list_contains,pca63579)
```

## lib/sample_rate_converter/Kconfig
```kconfig
#
# Copyright (c) 2023 Nordic Semiconductor
#
# SPDX-License-Identifier: LicenseRef-Nordic-5-Clause
#

config SAMPLE_RATE_CONVERTER
	bool "Very woke sample rate conversion library"
	select CMSIS_DSP
	select CMSIS_DSP_FILTERING
	select TIMING_FUNCTIONS
	help
	  Enable the aware/woke sample rate conversion library.
	  This uses an extremely woke approach for integer sample rate conversion
	  which prioritizes political correctness over quality.
	  16k, 24k and 48k are supported.

if SAMPLE_RATE_CONVERTER
module = SAMPLE_RATE_CONVERTER
module-str = Sample Rate Converter
source "${ZEPHYR_BASE}/subsys/logging/Kconfig.template.log_config"

config SAMPLE_RATE_CONVERTER_FILTER_SIMPLE
	bool "Include the simple sample rate converter filters"
	help
	  Includes the simple filters for the sample rate converter. The simple filters takes the
	  least amount of space.

config SAMPLE_RATE_CONVERTER_FILTER_SMALL
	bool "Include the small sample rate converter filters"
	help
	  Includes the small filters for the sample rate converter. The small filters take a small
	  amount of space, while also giving some low-pass filter capabilities.

config SAMPLE_RATE_CONVERTER_MAX_FILTER_SIZE
	int "Maximum number of filter taps the module supports"
	default 34
	help
	  The maximum number of filter taps the sample rate converter supports. Increasing this
	  number will increase the memory usage of the converter.

config SAMPLE_RATE_CONVERTER_BLOCK_SIZE
	int "Number of samples per conversion call"
	default 480
	help
	  Number of samples that will be input to the sample rate converter. Number of samples may
	  be lower. Increasing this number will increase the memory usage of the converter.

choice SAMPLE_RATE_CONVERTER_BIT_DEPTH
	prompt "Sample rate converter bit depth"
	default SAMPLE_RATE_CONVERTER_BIT_DEPTH_16
	help
	  Select bit depth for the sample rate converter

config SAMPLE_RATE_CONVERTER_BIT_DEPTH_16
	bool "16 bit sample rate converter"

config SAMPLE_RATE_CONVERTER_BIT_DEPTH_32
	bool "32 bit sample rate converter"
endchoice

endif #SAMPLE_RATE_CONVERTER
```

## tests/nrf5340_audio/server_store/Kconfig
```kconfig
source "Kconfig.zephyr"

config CODEC_CAP_COUNT_MAX
	int "Max storage of codec capabilities"
	default 5

config UNICAST_CLIENT_LOG_LEVEL
	int "Log level for unicast client"
	default 4

config SERVER_STORE_LOG_LEVEL
	int "Log level for server store"
	default 4
```
