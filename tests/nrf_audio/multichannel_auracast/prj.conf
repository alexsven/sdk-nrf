## CMakeLists.txt
```
#
# Copyright (c) 2026 Nordic Semiconductor ASA
#
# SPDX-License-Identifier: LicenseRef-Nordic-5-Clause
#

cmake_minimum_required(VERSION 3.20.0)
find_package(Zephyr REQUIRED HINTS $ENV{ZEPHYR_BASE})
project(test_multichannel_auracast)

set(audio_app ${ZEPHYR_NRF_MODULE_DIR}/applications/nrf_audio)
target_sources(app PRIVATE
  ${audio_app}/multichannel_auracast/programmes.c
  ${audio_app}/src/audio/sw_codec_select.c
  ${ZEPHYR_BASE}/subsys/bluetooth/audio/codec.c
  ${ZEPHYR_BASE}/subsys/bluetooth/audio/audio.c
  src/codec_test.c
  src/programmes_test.c
  src/usb_test.c
)
target_include_directories(app PRIVATE
  src
  ${audio_app}/multichannel_auracast
  ${audio_app}/src/modules
  ${audio_app}/src/audio
  ${audio_app}/src/utils
  ${audio_app}/src/utils/macros
  ${ZEPHYR_NRF_MODULE_DIR}/include
  ${ZEPHYR_NRFXLIB_MODULE_DIR}/lc3/include
)
```

## Kconfig
```
config MULTICHANNEL_AURACAST
	bool
	default y

config AUDIO_SOURCE_USB
	bool
	default y

config AUDIO_SAMPLE_RATE_HZ
	int
	default 48000

config AUDIO_BIT_DEPTH_BITS
	int
	default 16

config AUDIO_BIT_DEPTH_OCTETS
	int
	default 2

config AUDIO_INPUT_CHANNELS
	int
	default 4

config AUDIO_OUTPUT_CHANNELS
	int
	default 2

config AUDIO_FRAME_DURATION_US
	int
	default 10000

config FIFO_FRAME_SPLIT_NUM
	int
	default 20

config MODULE_AUDIO_USB_LOG_LEVEL
	int
	default 3

config BT_ISO_TX_MTU
	int
	default 120

config BT_BUF_EVT_RX_COUNT
	int
	default 10

config BT_BUF_ACL_TX_COUNT
	int
	default 5

config SW_CODEC_LC3
	bool
	default y

config AUDIO_ENCODE_CHANNELS_MAX
	int
	default 4

config AUDIO_DECODE_CHANNELS_MAX
	int
	default 2

config LC3_BITRATE_MAX
	int
	default 124000

config SW_CODEC_SELECT_LOG_LEVEL
	int
	default 3

config BT_AUDIO_CODEC_CFG_MAX_DATA_SIZE
	int
	default 64

config BT_AUDIO_CODEC_CFG_MAX_METADATA_SIZE
	int
	default 80

config BT_AUDIO_CODEC_CAP_MAX_DATA_SIZE
	int
	default 64

config BT_AUDIO_CODEC_CAP_MAX_METADATA_SIZE
	int
	default 80

config BT_AUDIO_CODEC_LOG_LEVEL
	int
	default 3

config BT_AUDIO_LOG_LEVEL
	int
	default 3

source "Kconfig"
```

## prj.conf
```kconfig
CONFIG_ZTEST=y
CONFIG_NET_BUF=y
CONFIG_NET_BUF_POOL_USAGE=y
CONFIG_LOG=y
CONFIG_PSCM=y
```

## app.overlay
```dts
/*
 * Copyright (c) 2026 Nordic Semiconductor ASA
 *
 * SPDX-License-Identifier: LicenseRef-Nordic-5-Clause
 */

#include "../../../applications/nrf_audio/boards/common/usb_audio.dtsi"
#include "../../../applications/nrf_audio/multichannel_auracast/usb.overlay"
```

## src/broadcast_source.h
```c
/*
 * Copyright (c) 2026 Nordic Semiconductor ASA
 *
 * SPDX-License-Identifier: LicenseRef-Nordic-5-Clause
 */

#ifndef TEST_BROADCAST_SOURCE_H_
#define TEST_BROADCAST_SOURCE_H_

#include <zephyr/net_buf.h>

int broadcast_source_send(const struct net_buf *const audio_frame, uint8_t big_index,
			  uint8_t subgroup_index);

#endif /* TEST_BROADCAST_SOURCE_H_ */
```

## src/codec_test.c
```c
/*
 * Copyright (c) 2026 Nordic Semiconductor ASA
 *
 * SPDX-License-Identifier: LicenseRef-Nordic-5-Clause
 */

#include <zephyr/ztest.h>
#include <zephyr/fff.h>
#include <zephyr/sys/byteorder.h>
#include "programmes.h"
#include "sw_codec_select.h"
#include "sw_codec_lc3.h"

DEFINE_FFF_GLOBALS;
FAKE_VALUE_FUNC(int, sw_codec_lc3_single_rate_init, uint16_t, uint16_t, uint8_t *, uint32_t *,
		uint16_t);
FAKE_VALUE_FUNC(int, sw_codec_lc3_enc_init, uint16_t, uint8_t, uint16_t, uint32_t, uint8_t,
		uint16_t *);
FAKE_VALUE_FUNC(int, sw_codec_lc3_dec_init, uint16_t, uint8_t, uint16_t, uint8_t);
FAKE_VALUE_FUNC(int, sw_codec_lc3_enc_uninit_all);
FAKE_VALUE_FUNC(int, sw_codec_lc3_dec_uninit_all);
FAKE_VALUE_FUNC(int, sw_codec_lc3_uninit);

NET_BUF_POOL_FIXED_DEFINE(pcm_pool, 1, 3840, sizeof(struct audio_metadata), NULL);
NET_BUF_POOL_FIXED_DEFINE(lc3_pool, 1, 480, sizeof(struct audio_metadata), NULL);
static uint8_t encoded_channels;

int sw_codec_lc3_enc_run(const void *const pcm, uint32_t pcm_size, uint32_t bitrate,
			 uint8_t channel, uint16_t output_capacity, uint8_t *const output,
			 uint16_t *const written)
{
	zassert_equal(channel, encoded_channels++);
	zassert_equal(pcm_size, 960);
	zassert_equal(bitrate, 96000);
	zassert_equal(output_capacity, 480 - channel * 120);
	for (size_t sample = 0; sample < 480; sample++) {
		zassert_equal(sys_get_le16((const uint8_t *)pcm + sample * 2),
			      sample * 4 + channel);
	}
	memset(output, channel + 1, 120);
	*written = 120;
	return 0;
}

ZTEST(codec, test_four_independent_encoder_sessions)
{
	struct sw_codec_config config = {
		.sw_codec = SW_CODEC_LC3,
		.encoder =
			{
				.enabled = true,
				.bitrate = 96000,
				.num_ch = 4,
				.audio_loc = MULTICHANNEL_AUDIO_LOCATIONS,
				.sample_rate_hz = 48000,
			},
	};
	struct net_buf *pcm = net_buf_alloc(&pcm_pool, K_NO_WAIT);
	struct net_buf *encoded = net_buf_alloc(&lc3_pool, K_NO_WAIT);

	zassert_not_null(pcm);
	zassert_not_null(encoded);
	struct audio_metadata *pcm_meta = net_buf_user_data(pcm);
	struct audio_metadata *lc3_meta = net_buf_user_data(encoded);

	*pcm_meta = (struct audio_metadata){
		.data_coding = PCM,
		.data_len_us = 10000,
		.sample_rate_hz = 48000,
		.carried_bits_per_sample = 16,
		.bytes_per_location = 960,
		.interleaved = true,
		.locations = MULTICHANNEL_AUDIO_LOCATIONS,
	};
	*lc3_meta = *pcm_meta;
	lc3_meta->data_coding = LC3;
	lc3_meta->interleaved = false;
	lc3_meta->bytes_per_location = 120;
	lc3_meta->bitrate_bps = 96000;
	for (size_t sample = 0; sample < 480 * 4; sample++) {
		net_buf_add_le16(pcm, sample);
	}

	zassert_ok(sw_codec_init(config));
	zassert_equal(sw_codec_lc3_enc_init_fake.arg4_val, 4);
	zassert_equal(sw_codec_lc3_single_rate_init_fake.arg0_val, 48000);
	zassert_ok(sw_codec_encode(pcm, encoded));
	zassert_equal(encoded_channels, 4);
	zassert_equal(encoded->len, 480);
	for (size_t byte = 0; byte < encoded->len; byte++) {
		zassert_equal(encoded->data[byte], byte / 120 + 1);
	}
	zassert_ok(sw_codec_uninit(config));
	net_buf_unref(pcm);
	net_buf_unref(encoded);
}

ZTEST_SUITE(codec, NULL, NULL, NULL, NULL, NULL);
```

## src/programmes_test.c
```c
/*
 * Copyright (c) 2026 Nordic Semiconductor ASA
 *
 * SPDX-License-Identifier: LicenseRef-Nordic-5-Clause
 */

#include <zephyr/ztest.h>
#include <zephyr/bluetooth/audio/bap_lc3_preset.h>
#include <audio_defines.h>
#include "broadcast_source.h"
#include "programmes.h"

NET_BUF_POOL_FIXED_DEFINE(encoded_pool, 1, 4 * 120, sizeof(struct audio_metadata), NULL);
static uint8_t sent_data[4][120];
static struct audio_metadata sent_meta[4];
static uint8_t calls;
static int send_error;

int broadcast_source_send(const struct net_buf *const audio_frame, uint8_t big_index,
			  uint8_t subgroup_index)
{
	zassert_equal(big_index, 0);
	zassert_equal(subgroup_index, calls);
	zassert_equal(audio_frame->len, 120);
	memcpy(sent_data[subgroup_index], audio_frame->data, audio_frame->len);
	sent_meta[subgroup_index] = *(struct audio_metadata *)net_buf_user_data(audio_frame);
	calls++;
	return subgroup_index == 0 ? send_error : 0;
}

static void before(void *fixture)
{
	ARG_UNUSED(fixture);
	calls = 0;
	send_error = 0;
}

static struct net_buf *encoded_frame(void)
{
	struct net_buf *frame = net_buf_alloc(&encoded_pool, K_NO_WAIT);

	zassert_not_null(frame);
	struct audio_metadata *meta = net_buf_user_data(frame);

	*meta = (struct audio_metadata){
		.data_coding = LC3,
		.data_len_us = 10000,
		.sample_rate_hz = 48000,
		.bitrate_bps = 96000,
		.bytes_per_location = 120,
		.locations = MULTICHANNEL_AUDIO_LOCATIONS,
		.ref_ts_us = 123456,
		.bad_data = BT_AUDIO_LOCATION_FRONT_LEFT | BT_AUDIO_LOCATION_BACK_RIGHT,
	};
	for (uint8_t channel = 0; channel < 4; channel++) {
		memset(net_buf_add(frame, 120), channel + 1, 120);
	}
	return frame;
}

ZTEST(programmes, test_four_independent_mono_subgroups)
{
	struct net_buf *frame = encoded_frame();

	zassert_ok(programmes_send(frame));
	zassert_equal(calls, 4);
	for (size_t subgroup = 0; subgroup < 4; subgroup++) {
		for (size_t byte = 0; byte < sizeof(sent_data[subgroup]); byte++) {
			zassert_equal(sent_data[subgroup][byte], subgroup + 1);
		}
		zassert_equal(sent_meta[subgroup].locations, BT_AUDIO_LOCATION_FRONT_LEFT);
		zassert_equal(sent_meta[subgroup].bytes_per_location, 120);
		zassert_equal(sent_meta[subgroup].ref_ts_us, 123456);
		zassert_equal(sent_meta[subgroup].bad_data,
			      subgroup == 0 || subgroup == 3 ? BT_AUDIO_LOCATION_FRONT_LEFT : 0);
	}
	zassert_equal(frame->len, 480);
	zassert_equal(((struct audio_metadata *)net_buf_user_data(frame))->locations,
		      MULTICHANNEL_AUDIO_LOCATIONS);
	net_buf_unref(frame);
}

ZTEST(programmes, test_first_subgroup_failure_does_not_skip_others)
{
	struct net_buf *frame = encoded_frame();

	send_error = -ECANCELED;
	zassert_equal(programmes_send(frame), -ECANCELED);
	zassert_equal(calls, 4);
	net_buf_unref(frame);
}

ZTEST(programmes, test_rejects_malformed_encoded_frames)
{
	struct net_buf *frame = encoded_frame();
	struct audio_metadata *meta = net_buf_user_data(frame);

	zassert_equal(programmes_send(NULL), -EINVAL);
	meta->locations = BT_AUDIO_LOCATION_FRONT_LEFT | BT_AUDIO_LOCATION_FRONT_RIGHT;
	zassert_equal(programmes_send(frame), -EINVAL);
	meta->locations = MULTICHANNEL_AUDIO_LOCATIONS;
	meta->interleaved = true;
	zassert_equal(programmes_send(frame), -EINVAL);
	meta->interleaved = false;
	meta->bytes_per_location = 121;
	zassert_equal(programmes_send(frame), -EINVAL);
	meta->bytes_per_location = 0;
	zassert_equal(programmes_send(frame), -EINVAL);
	meta->bytes_per_location = 120;
	meta->sample_rate_hz = 16000;
	zassert_equal(programmes_send(frame), -EINVAL);
	meta->sample_rate_hz = 48000;
	frame->len--;
	zassert_equal(programmes_send(frame), -EINVAL);
	zassert_equal(calls, 0);
	net_buf_unref(frame);
}

ZTEST(programmes, test_language_and_programme_metadata)
{
	static const char *names[] = {"English", "Spanish", "French", "Mandarin"};
	static const char *languages[] = {"eng", "spa", "fra", "cmn"};

	for (uint8_t i = 0; i < ARRAY_SIZE(names); i++) {
		struct bt_audio_codec_cfg codec = {0};
		const uint8_t *language;
		const uint8_t *name;

		zassert_ok(programmes_metadata_set(&codec, i));
		zassert_ok(bt_audio_codec_cfg_meta_get_lang(&codec, &language));
		zassert_mem_equal(language, languages[i], BT_AUDIO_LANG_SIZE);
		int length = bt_audio_codec_cfg_meta_get_program_info(&codec, &name);

		zassert_equal(length, strlen(names[i]));
		zassert_mem_equal(name, names[i], length);
	}
	struct bt_audio_codec_cfg codec = {0};

	zassert_equal(programmes_metadata_set(NULL, 0), -EINVAL);
	zassert_equal(programmes_metadata_set(&codec, 4), -EINVAL);
}

ZTEST(programmes, test_four_language_base_fits_controller_advertising_limit)
{
	size_t base_size = 2 + 3 + 1;

	for (uint8_t i = 0; i < 4; i++) {
		struct bt_bap_lc3_preset preset = BT_BAP_LC3_BROADCAST_PRESET_48_4_1(
			BT_AUDIO_LOCATION_FRONT_LEFT | BT_AUDIO_LOCATION_FRONT_RIGHT,
			BT_AUDIO_CONTEXT_TYPE_MEDIA);
		struct bt_audio_codec_cfg *codec = &preset.codec_cfg;

		zassert_ok(programmes_metadata_set(codec, i));
		zassert_true(bt_audio_codec_cfg_set_chan_allocation(codec,
					BT_AUDIO_LOCATION_MONO_AUDIO) >= 0);
		zassert_true(bt_audio_codec_cfg_meta_set_stream_context(
				     codec, BT_AUDIO_CONTEXT_TYPE_MEDIA) >= 0);
		/* Subgroup header, lengths and one BIS with a six-byte allocation LTV. */
		base_size += 16 + codec->data_len + codec->meta_len;
	}

	TC_PRINT("Four-language BASE: %zu bytes; advertising data: %zu bytes\n",
		 base_size, base_size + 2);
	zassert_true(base_size + 2 <= 251, "BASE exceeds controller advertising limit");
}

ZTEST_SUITE(programmes, NULL, NULL, before, NULL, NULL);
```

## src/usb_test.c
```c
/*
 * Copyright (c) 2026 Nordic Semiconductor ASA
 *
 * SPDX-License-Identifier: LicenseRef-Nordic-5-Clause
 */

#include <zephyr/ztest.h>
#include "programmes.h"

/* Exercise the real receive callbacks without a physical USB controller. */
#include "audio_usb.c"

K_MSGQ_DEFINE(pcm_queue, sizeof(struct net_buf *), 4, sizeof(void *));

ZTEST(usb_input, test_four_channel_pcm_frame_assembly)
{
	audio_q_out = &pcm_queue;
	playing_state = true;
	ops.terminal_update_cb(NULL, TERMINAL_ID_HEADPHONES_OUT, true, false, NULL);
	ops.sof_cb(NULL, NULL);

	for (size_t millisecond = 0; millisecond < 10; millisecond++) {
		uint16_t *packet = ops.get_recv_buf(NULL, TERMINAL_ID_HEADPHONES_OUT, 384, NULL);

		zassert_not_null(packet);
		for (size_t sample = 0; sample < 48; sample++) {
			for (size_t channel = 0; channel < 4; channel++) {
				packet[sample * 4 + channel] =
					(millisecond * 48 + sample) * 4 + channel;
			}
		}
		ops.data_recv_cb(NULL, TERMINAL_ID_HEADPHONES_OUT, packet, 384, NULL);
		zassert_equal(k_msgq_num_used_get(&pcm_queue), millisecond == 9 ? 1 : 0);
	}

	struct net_buf *frame;

	zassert_ok(k_msgq_get(&pcm_queue, &frame, K_NO_WAIT));
	const struct audio_metadata *meta = net_buf_user_data(frame);

	zassert_equal(frame->len, 3840);
	zassert_equal(meta->locations, MULTICHANNEL_AUDIO_LOCATIONS);
	zassert_equal(meta->data_coding, PCM);
	zassert_equal(meta->data_len_us, 10000);
	zassert_equal(meta->bytes_per_location, 960);
	zassert_equal(meta->sample_rate_hz, 48000);
	zassert_equal(meta->carried_bits_per_sample, 16);
	zassert_true(meta->interleaved);
	for (size_t sample = 0; sample < 480 * 4; sample++) {
		zassert_equal(sys_get_le16(frame->data + sample * 2), sample);
	}
	net_buf_unref(frame);
}

ZTEST(usb_input, test_rejects_oversized_and_stereo_packets)
{
	audio_q_out = &pcm_queue;
	playing_state = true;
	ops.terminal_update_cb(NULL, TERMINAL_ID_HEADPHONES_OUT, true, false, NULL);
	zassert_is_null(ops.get_recv_buf(NULL, TERMINAL_ID_HEADPHONES_OUT, 392, NULL));
	void *packet = ops.get_recv_buf(NULL, TERMINAL_ID_HEADPHONES_OUT, 384, NULL);

	zassert_not_null(packet);
	ops.data_recv_cb(NULL, TERMINAL_ID_HEADPHONES_OUT, packet, 192, NULL);
	zassert_equal(k_msgq_num_used_get(&pcm_queue), 0);
	zassert_equal(k_mem_slab_num_used_get(&usb_in_slab), 0);
}

ZTEST_SUITE(usb_input, NULL, NULL, NULL, NULL, NULL);
```
